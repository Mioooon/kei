// map
int eye_map[][2] = {
  {12, 23},     {13, 23},     {12, 24},     {13, 24},     {14, 24},     {15, 24},     {12, 25},     {13, 25},     {14, 25},     {15, 25}, 
  {16, 25},     {17, 25},     {12, 26},     {13, 26},     {14, 26},     {15, 26},     {16, 26},     {17, 26},     {18, 26},     {19, 26}, 
  {20, 26},     {12, 27},     {13, 27},     {14, 27},     {15, 27},     {16, 27},     {17, 27},     {18, 27},     {19, 27},     {20, 27}, 
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  {73, 73},     {74, 73},     {60, 74},     {61, 74},     {62, 74},     {63, 74},     {64, 74},     {65, 74},     {66, 74}
};

//////////////////////////////////////////////////////////////////////////////////////////////////////////////////////////////////////////

#include <LovyanGFX.hpp>

class LGFX_ST7789 : public lgfx::LGFX_Device
{
  lgfx::Panel_ST7789 _panel_instance;
  lgfx::Bus_SPI _bus_instance;

public:
  LGFX_ST7789()
  {
    {
      // SPIバス設定
      auto cfg = _bus_instance.config();
      cfg.spi_host = 0;  // RP2040のSPI0を使用
      cfg.spi_mode = 0;
      cfg.freq_write = 40000000;  // 書き込み速度 (ボードによって調整)
      cfg.freq_read  = 16000000;  // 読み込み速度

      // RP2040のSPI0ピン配置 (必要に応じて変更)
      cfg.pin_sclk = 18;  // SCK
      cfg.pin_mosi = 19;  // MOSI
      cfg.pin_miso = -1;  // MISO (使用しない)
      cfg.pin_dc   = 22;  // DC (データコマンド制御)

      _bus_instance.config(cfg);
      _panel_instance.setBus(&_bus_instance);
    }

    {
    // パネル設定
    auto panel_cfg = _panel_instance.config();
    panel_cfg.pin_cs   = 17;  // CS
    panel_cfg.pin_rst  = 23;  // RESET
    panel_cfg.pin_busy = -1;  // BUSY (未使用)

    panel_cfg.memory_width  = 170;
    panel_cfg.memory_height = 320;
    panel_cfg.panel_width   = 170;
    panel_cfg.panel_height  = 320;
    panel_cfg.offset_x      = 35;
    panel_cfg.offset_y      = 0;  // 必要に応じて調整
    panel_cfg.offset_rotation = 3;
    panel_cfg.rgb_order     = false;
    panel_cfg.invert        = true;

    _panel_instance.config(panel_cfg);
    }
    setPanel(&_panel_instance);
  }
};

LGFX_ST7789 lcd;

void drawBackground(){
  uint32_t BG_COLOR_1 = lcd.color888(50, 59, 100);
  uint32_t BG_COLOR_2 = lcd.color888(66, 80, 100);
  int pitch = 7;
  for(int i = 0; i < 170; i+=pitch){
    for(int j = 0; j < 320; j++){
      if(i/pitch%2 == 0)
        lcd.drawGradientLine(j, i, j, i+pitch-1, BG_COLOR_1, BG_COLOR_2);
      else
        lcd.drawGradientLine(j, i, j, i+pitch-1, BG_COLOR_2, BG_COLOR_1);
    }
  }
}

void normal(){
  uint32_t FACE_COLOR = lcd.color888(83,100,100);
  drawBackground();
  // eyes
  int start_x = 50;
  int start_y = 55;
  lcd.fillRect(start_x, start_y, 80, 10, FACE_COLOR);
  lcd.fillRoundRect(start_x+5, start_y+10, 50, 40, 20, FACE_COLOR);
  lcd.fillRect(start_x+5, start_y+10, 50, 20, FACE_COLOR);
  start_x = 200;
  lcd.fillRect(start_x, start_y, 80, 10, FACE_COLOR);
  lcd.fillRoundRect(start_x+5, start_y+10, 50, 40, 20, FACE_COLOR);
  lcd.fillRect(start_x+5, start_y+10, 50, 20, FACE_COLOR);
  // mouth
  int width = 80;
  int height = 15;
  start_x = 320/2 - width/2;
  start_y = 130;
  lcd.fillRoundRect(start_x, start_y, width, height, 3, FACE_COLOR);
}

void angry(){
  uint32_t FACE_COLOR = lcd.color888(83,100,100);
  drawBackground();
  // eyes
  int start_x = 30;
  int start_y = 20;
  int numRows = sizeof(eye_map) / sizeof(eye_map[0]);
  for(int i = 0; i < numRows; i++){
    lcd.drawPixel(eye_map[i][0] + start_x, eye_map[i][1] + start_y, FACE_COLOR);
  }
  start_x = 190;
  for(int i = 0; i < numRows; i++){
    lcd.drawPixel((100-eye_map[i][0]) + start_x, eye_map[i][1] + start_y, FACE_COLOR);
  }
  // mouth
  int width = 60;
  int height = 40;
  start_x = 320/2 - width/2;
  start_y = 110;
  lcd.fillRoundRect(start_x, start_y, width, height, 3, FACE_COLOR);
}

void setup()
{
  lcd.init();
  lcd.setRotation(0);
  lcd.fillScreen(TFT_SKYBLUE);
  lcd.setTextColor(TFT_WHITE, TFT_SKYBLUE);
  lcd.drawString("Hello, ST7789!", 0, 0, &fonts::Font2);
  normal();
  delay(1000);
  angry();
}

void loop()
{
}

//倒立振子用
// void setup1()


